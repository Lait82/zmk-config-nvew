## boards/shields/nvew/Kconfig.defconfig
```kconfig
if SHIELD_NVEW_LEFT || SHIELD_NVEW_RIGHT

config ZMK_KEYBOARD_NAME
    default "NVEW"

config ZMK_SPLIT
    default y

config ZMK_SPLIT_BLE
    default y

endif

if SHIELD_NVEW_RIGHT
config ZMK_SPLIT_ROLE_CENTRAL
    default y

config SSD1306
    default y

config ZMK_DISPLAY
    default y

config ZMK_DISPLAY_STATUS_SCREEN
    default y
endif

if SHIELD_NVEW_LEFT
config ZMK_SPLIT_ROLE_CENTRAL
    default n
endif
```

## boards/shields/nvew/Kconfig.shield
```kconfig
config SHIELD_NVEW_RIGHT
    def_bool $(shields_list_contains,nvew_right)

config SHIELD_NVEW_LEFT
    def_bool $(shields_list_contains,nvew_left)

config ZMK_DISPLAY
    bool "Enable OLED display support"
    default n

config SSD1306
    bool "Enable SSD1306 OLED driver"
    default n

config ZMK_DISPLAY_STATUS_SCREEN
    bool "Enable ZMK status screen on OLED"
    default n

config CONFIG_EC11
    bool "Enable wheel encoder"
    default n

config CONFIG_EC11_TRIGGER_GLOBAL_THREAD
    bool "Run the wheel encoder on the global thread"
    default n
```

## config/boards/shields/nvew/Kconfig.shield
```kconfig
config SHIELD_NVEW_RIGHT
    def_bool $(shields_list_contains,nvew_right)

config SHIELD_NVEW_LEFT
    def_bool $(shields_list_contains,nvew_left)
```
