#include <dt-bindings/zmk/matrix_transform.h>
// #include "nvew.dtsi"

/ {    
    kscan0: kscan {
        // row-gpios = <&pro_micro 15 (GPIO_ACTIVE_HIGH | GPIO_PULL_DOWN)>,
        // <&pro_micro 14 (GPIO_ACTIVE_HIGH | GPIO_PULL_DOWN)>,
        // <&pro_micro 16 (GPIO_ACTIVE_HIGH | GPIO_PULL_DOWN)>;

        row-gpios
            = <&pro_micro 4 (GPIO_ACTIVE_HIGH | GPIO_PULL_DOWN)> // Row 1 from the schematic file
            , <&pro_micro 3 (GPIO_ACTIVE_HIGH | GPIO_PULL_DOWN)> // Row 2 from the schematic file
            , <&pro_micro 6 (GPIO_ACTIVE_HIGH | GPIO_PULL_DOWN)> // Row 3 from the schematic file
            , <&pro_micro 16 (GPIO_ACTIVE_HIGH | GPIO_PULL_DOWN)> // Row 4 from the schematic file
            ;
        
        // col-gpios = <&pro_micro 19 GPIO_ACTIVE_HIGH>,
        // <&pro_micro 20 GPIO_ACTIVE_HIGH>,
        // <&pro_micro 21 GPIO_ACTIVE_HIGH>;

        col-gpios = <&pro_micro 18 (GPIO_ACTIVE_HIGH | GPIO_PULL_DOWN)> // Col 1 from the schematic file
            , <&pro_micro 15 (GPIO_ACTIVE_HIGH | GPIO_PULL_DOWN)> // Col 2 from the schematic file
            , <&pro_micro 14 (GPIO_ACTIVE_HIGH | GPIO_PULL_DOWN)> // Col 3 from the schematic file
            , <&pro_micro 8 (GPIO_ACTIVE_HIGH | GPIO_PULL_DOWN)> // Col 4 from the schematic file
            , <&pro_micro 7 (GPIO_ACTIVE_HIGH | GPIO_PULL_DOWN)> // Col 5 from the schematic file
            , <&pro_micro 5 (GPIO_ACTIVE_HIGH | GPIO_PULL_DOWN)> // Col 6 from the schematic file
            , <&pro_micro 2 (GPIO_ACTIVE_HIGH | GPIO_PULL_DOWN)> // Col 7 from the schematic file
            ;
    };

};
&default_transform {
    col-offset = <1>;
};