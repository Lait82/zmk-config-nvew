#include <dt-bindings/zmk/matrix_transform.h>
#include "nvew.dtsi"

/ {
    &default_transform {
        col-offset = <1>;
    };

    kscan0: kscan {
        row-gpios = <&pro_micro 15 (GPIO_ACTIVE_HIGH | GPIO_PULL_DOWN)>,
                    <&pro_micro 14 (GPIO_ACTIVE_HIGH | GPIO_PULL_DOWN)>,
                    <&pro_micro 16 (GPIO_ACTIVE_HIGH | GPIO_PULL_DOWN)>;
    
        col-gpios = <&pro_micro 19 GPIO_ACTIVE_HIGH>,
                    <&pro_micro 20 GPIO_ACTIVE_HIGH>,
                    <&pro_micro 21 GPIO_ACTIVE_HIGH>;
    };
};